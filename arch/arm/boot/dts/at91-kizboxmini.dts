/*
 * at91-kizboxmini.dts - Device Tree file for Overkiz Kizbox mini board
 *
 * Copyright (C) 2015 Antoine AUBERT <a.aubert@overkiz.com>
 *                    Kévin RAYMOND <k.raymond@overkiz.com>
 *
 * Licensed under GPLv2 or later.
 */
/dts-v1/;
#include "at91-kizboxmini_common.dtsi"

/ {
	model = "Overkiz Kizbox mini";
	compatible = "overkiz,kizboxmini", "atmel,at91sam9g25", "atmel,at91sam9x5", "atmel,at91sam9";

	ahb {
		apb {
			usart0: serial@f801c000 {
				status = "okay";
			};
		};
	};
};
