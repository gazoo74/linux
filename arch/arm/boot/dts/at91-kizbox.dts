/*
 * at91-kizbox.dts - Device Tree file for Overkiz Kizbox board
 *
 * Copyright (C) 2012-2014 Boris BREZILLON <b.brezillon@overkiz.com>
 *               2014-2015 Gaël PORTAY <g.portay@overkiz.com>
 *                    2015 Antoine AUBERT <a.aubert@overkiz.com>
 *                         Kévin RAYMOND <k.raymond@overkiz.com>
 *
 * Licensed under GPLv2 or later.
 */
/dts-v1/;
#include "at91-kizbox_common.dtsi"

/ {
	model = "Overkiz Kizbox";
	compatible = "overkiz,kizbox", "atmel,at91sam9g20", "atmel,at91sam9";

	ahb {
		usb0: ohci@00500000 {
			num-ports = <1>;
			status = "okay";
		};
	};
};
